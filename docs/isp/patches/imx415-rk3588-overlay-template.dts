/*
 * IMX415 RK3588 device-tree overlay TEMPLATE.
 *
 * This file intentionally contains no board-specific register, GPIO, I2C bus,
 * DPHY, or regulator values. Replace every __BOARD_SPECIFIC__ token from the
 * target schematic/BSP before compiling. It is a review artifact, not an
 * applicable patch for an unknown board.
 */

&__BOARD_I2C_CONTROLLER__ {
    status = "okay";

    imx415: camera@__I2C_ADDRESS__ {
        compatible = "sony,imx415"; /* verify target BSP compatible */
        reg = <__I2C_ADDRESS__>;
        clocks = <&__BOARD_XCLK__>;
        clock-names = "inck";
        reset-gpios = <&__BOARD_GPIO__ __RESET_PIN__ GPIO_ACTIVE_LOW>;
        pwdn-gpios = <&__BOARD_GPIO__ __PWDN_PIN__ GPIO_ACTIVE_HIGH>;
        avdd-supply = <&__BOARD_AVDD__>;
        dvdd-supply = <&__BOARD_DVDD__>;
        dovdd-supply = <&__BOARD_DOVDD__>;

        port {
            imx415_out: endpoint {
                data-lanes = <1 2 3 4>; /* verify 2/4 lane module */
                link-frequencies = /bits/ 64 <__LINK_FREQUENCY__>;
                remote-endpoint = <&__CSI_IN_ENDPOINT__>;
            };
        };
    };
};

/* Add the reciprocal endpoint under the actual RK3588 CSI/DPHY node. */
